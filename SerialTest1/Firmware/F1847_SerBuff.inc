;====================================================================================================
;
;    Filename:      SerBuff.inc
;    Date:          5/25/2008                                     
;    File Version:  1.0
;
;    Author:        David M. Flynn
;    Company:       Oxford V.U.E., Inc.
;    E-Mail:        dflynn@TrainCircuits.com
;    Web Site:      http://www.TrainCircuits.com
;
;====================================================================================================
;====================================================================================================
; Notes:
;
; History:
; 1.0      5/25/2008	First Rev'd version
;
;=============================================================================================
; Bank2 Variables:
;
;Ser_In_Bytes	RES	1	;Bytes in Ser_In_Buff
;Ser_Out_Bytes	RES	1	;Bytes in Ser_Out_Buff
;Ser_In_InPtr	RES	1
;Ser_In_OutPtr	RES	1
;Ser_Out_InPtr	RES	1
;Ser_Out_OutPtr	RES	1
;Ser_In_Buff	RES	d'32'
;Ser_Out_Buff	RES	d'32'
;
; Routines	(Bank In/Bank Out)
;
; StoreSerIn	(X/0) Put the byte in W into the serial input buffer
; Bank0Rtn	(X/0) mBank0,Return
; GetSerIn	(X/0) Get a byte from the serial input buffer
; GetSerOutBytes	(X/0) Get the number of bytes in the serial ouput buffer
; StoreSerOut	(X/0) Put the byte in W into the serial output buffer
; POP_SerOut	(X/0) Remove the last char stored in the output buffer
; GetSerOut	(X/0) Get a byte from the serial Output buffer W=Byte, Param78:0=ValidFlag
; RS232_Parse	(X/0) Parse any bytes received by the serial port
;	 Receive 0xFF,kIDCode,ADC Low,ADC High,Buttons
;	 Only the sync byte can be 0xFF
;=============================================================================================
;=============================================================================================
; *** Put in main loop ***
; Handle Serial Communications
;	BTFSC	PIR1,TXIF	;TX done?
;	CALL	TX_TheByte	; Yes
;
;=======================================================================================
; If the serial data has been sent and there are bytes in the buffer, send the next byte
;
;ML_Ser_Out	BTFSS	DataSentFlag
;	GOTO	ML_Ser_End
;	CALL	GetSerOut
;	BTFSS	Param78,0
;	GOTO	ML_Ser_End
;	MOVWF	TXByte
;	BCF	DataSentFlag
;ML_Ser_End
;
;=============================================================================================
; *** Put in Init section ***
; setup serial I/O
;	bsf	_RP0	; bank 1
;	MOVLW	TXSTA_Value
;	MOVWF	TXSTA
;	MOVLW	BaudRate
;	MOVWF	SPBRG
;	BSF	PIE1,RCIE	; Serial Receive interupt
;	bcf	_RP0	; bank 0
;	MOVLW	RCSTA_Value
;	MOVWF	RCSTA
;	BSF	INTCON,PEIE	;Peripheral IRQ Enable
;
;===============================================================================================
; *** Put in ISR ***
;-----------------------------------------------------------------
;AUSART Serial ISR
;
;IRQ_Ser	BTFSS	PIR1,RCIF	;RX has a byte?
;	GOTO	IRQ_Ser_End
;ISR safe version of RX_TheByte
;	MOVF	RCSTA,W
;	ANDLW	0x06
;	SKPZ		;Frame or Overrun Err?
;	GOTO	IRQ_Ser_Err	; yes
;	MOVF	RCREG,W	;Clear RCIF, read data
;	MOVWF	RXByte
;	GOTO	IRQ_Ser_1
;
;IRQ_Ser_Err	MOVF	RCREG,W	;bad byte so drop it
;	BCF	RCSTA,CREN
;	BCF	RCSTA,FERR
;	BCF	RCSTA,OERR
;	BSF	RCSTA,CREN
;	GOTO	IRQ_Ser_End
;
; move any serial data received into the 32 byte input buffer
;
;IRQ_Ser_1	
; ISR safe version of StoreSerIn
;	BSF	_RP1	;Bank2
;	INCF	Ser_In_Bytes,F
;	MOVF	Ser_In_InPtr,W
;	ANDLW	0x1F
;	INCF	Ser_In_InPtr,F
;	BCF	_RP1	;Bank0
;	ADDLW	low Ser_In_Buff
;	MOVWF	FSR
;	BSF	_IRP
;	MOVF	RXByte,W
;	MOVWF	INDF
;
;IRQ_Ser_End
;
;=============================================================================================
; Put the byte in W into the serial input buffer
;
; Entry: W = byte to store
; Exit: none
; Ram Used: Param78, FSR
;
StoreSerIn	MOVWF	Param78
	mBank2
	INCF	Ser_In_Bytes,F
;	
	MOVF	Ser_In_InPtr,W
	ANDLW	0x1F
	INCF	Ser_In_InPtr,F
	ADDLW	low Ser_In_Buff
	MOVWF	FSR
	BSF	_IRP
	MOVF	Param78,W
	MOVWF	INDF
Bank0Rtn	mBank0
	RETURN
;
;================================================================================================
; Get a byte from the serial input buffer
;
; Entry: none
; Exit: W=byte from buffer, Param78,0=valid
;
GetSerIn	mBank2
	BCF	Param78,0	;no data
	MOVF	Ser_In_Bytes,F
	SKPNZ
	GOTO	Bank0Rtn
	BSF	Param78,0
	DECF	Ser_In_Bytes,F
	MOVF	Ser_In_OutPtr,W
	ANDLW	0x1F
	INCF	Ser_In_OutPtr,F
	ADDLW	low Ser_In_Buff
	MOVWF	FSR
	BSF	_IRP
	MOVF	INDF,W
	GOTO	Bank0Rtn
;
;=============================================================================================
; Get the number of bytes in the serial ouput buffer
;
; Entry: none
; Exit: W=bytes in buffer, Z
;
GetSerOutBytes	mBank2
	MOVF	Ser_Out_Bytes,W
	GOTO	Bank0Rtn
;
;=============================================================================================
; Put the byte in W into the serial output buffer
;
; Entry: W = byte to store
; Exit: Param78 & W = byte stored
;
StoreSerOut	MOVWF	Param78
	mBank2
	INCF	Ser_Out_Bytes,F
;	
	MOVF	Ser_Out_InPtr,W
	ANDLW	0x1F
	INCF	Ser_Out_InPtr,F
	ADDLW	low Ser_Out_Buff
	MOVWF	FSR
	BSF	_IRP
	MOVF	Param78,W
	MOVWF	INDF
	GOTO	Bank0Rtn
;
;=============================================================================================
; Remove the last char stored in the output buffer
;
POP_SerOut	mBank2
	MOVF	Ser_Out_Bytes,F
	SKPNZ
	GOTO	Bank0Rtn
	DECF	Ser_Out_Bytes,F
	DECF	Ser_Out_InPtr,F
	GOTO	Bank0Rtn
;
;=============================================================================================
; Get a byte from the serial Output buffer
;
; Entry: none
; Exit: W=byte from buffer, Param78,0=valid
;
GetSerOut	mBank2
	BCF	Param78,0	;no data
	MOVF	Ser_Out_Bytes,F
	SKPNZ
	GOTO	Bank0Rtn
	BSF	Param78,0
	DECF	Ser_Out_Bytes,F
	MOVF	Ser_Out_OutPtr,W
	ANDLW	0x1F
	INCF	Ser_Out_OutPtr,F
	ADDLW	low Ser_Out_Buff
	MOVWF	FSR
	BSF	_IRP
	MOVF	INDF,W
	GOTO	Bank0Rtn
;
;===============================================================================================
;===============================================================================================
; Bank0 variable used by RS232_Parse:
;
;Flags4	RES	1
;#Define	SyncByteRXd	Flags4,0
;#Define	IDCodeRXd	Flags4,1
;#Define	ADC_Val_LoRXd	Flags4,2
;#Define	ADC_Val_HiRXd	Flags4,3
;#Define	ButtonsRXd	Flags4,4
;#Define	ErrorDetected	Flags4,6
;#Define	NotMyIDFlag	Flags4,7
;
;RX_TempADC_Value	RES	2
;RX_TempButtons	RES	1
;RX_ADC_Value	RES	2
;RX_Buttons	RES	1
;
; *** put in main loop
;	CALL	RS232_Parse
;
;===============================================================================================
; Parse any bytes received by the serial port
;
; Receive 0xFF,kIDCode,ADC Low,ADC High,Buttons
; Only the sync byte can be 0xFF
;
; Entry: none
; Exit: none
; Ram Used: Param78, FSR
; Calls (1+0): GetSerIn
;
RS232_Parse	CALL	GetSerIn
	BTFSS	Param78,0
	RETURN
;
	MOVWF	Param78	;Data Byte RXd
; Command inturpreter
;
RS232_Parse_Sync	MOVF	Flags4,F
	SKPZ		;Beginning new packet?
	GOTO	RS232_Parse_1	; No
	MOVLW	0xFF
	SUBWF	Param78,W
	SKPNZ		;Sync byte OK?
	BSF	SyncByteRXd	; Yes
	GOTO	RS232_Parse
;
; ID Code
RS232_Parse_1	MOVLW	0x01	;SyncByteRXd
	SUBWF	Flags4,W
	SKPZ		;SyncByteRXd only?
	GOTO	RS232_Parse_2	; No
	MOVLW	kIDCode
	SUBWF	Param78,W
	SKPZ		;IDCode is a match?
	GOTO	RS232_Parse_BadID	; No
	BSF	IDCodeRXd
	GOTO	RS232_Parse
;
; ADC LSB
RS232_Parse_2	MOVLW	0x03	;SyncByteRXd+IDCodeRXd
	SUBWF	Flags4,W
	SKPZ		;Looking for low ADC?
	GOTO	RS232_Parse_3	; No
	BSF	ADC_Val_LoRXd
	MOVF	Param78,W
	MOVWF	RX_TempADC_Value
	INCF	Param78,W
	SKPZ		;Is this a sync byte?
	GOTO	RS232_Parse	; No
	CLRF	Flags4
	BCF	DataValidFlag
	GOTO	RS232_Parse_Sync
;
; ADC MSB
RS232_Parse_3	MOVLW	0x07	;SyncByteRXd+IDCodeRXd+ADC_Val_LoRXd
	SUBWF	Flags4,W
	SKPZ		;Looking for high ADC?
	GOTO	RS232_Parse_4	; No
	BSF	ADC_Val_HiRXd
	MOVF	Param78,W
	MOVWF	RX_TempADC_Value+1
	INCF	Param78,W
	SKPZ		;Is this a sync byte?
	GOTO	RS232_Parse	; No
	CLRF	Flags4
	BCF	DataValidFlag
	GOTO	RS232_Parse_Sync
;
; Buttons
RS232_Parse_4	MOVLW	0x0F	;SyncByteRXd+IDCodeRXd+ADC_Val_LoRXd+ADC_Val_HiRXd
	SUBWF	Flags4,W
	SKPZ		;Looking for Buttons?
	GOTO	RS232_Parse_5	; No
	BSF	ButtonsRXd
	MOVF	Param78,W
	MOVWF	RX_TempButtons
	INCF	Param78,W
	SKPZ		;Is this a sync byte?
	GOTO	RS232_Parse_Done	; No
	CLRF	Flags4
	BCF	DataValidFlag
	GOTO	RS232_Parse_Sync
;
RS232_Parse_5	BTFSS	NotMyIDFlag
	GOTO	RS232_ParseBadByte
	BTFSC	ADC_Val_HiRXd
	BSF	ButtonsRXd
	BTFSC	ADC_Val_LoRXd
	BSF	ADC_Val_HiRXd
	BTFSC	IDCodeRXd
	BSF	ADC_Val_LoRXd
	BTFSC	ButtonsRXd	;Done rx'ing the other guy's packet?
	CLRF	Flags4	; Yes
	INCF	Param78,W
	SKPZ		;Is this a sync byte?
	GOTO	RS232_Parse	; No
RS232_ParseBadByte	CLRF	Flags4
	BCF	DataValidFlag
	GOTO	RS232_Parse_Sync
;
RS232_Parse_BadID	BTFSC	Param78,7	;all ID's have this bit set
	BSF	IDCodeRXd
	BSF	NotMyIDFlag
	BTFSS	IDCodeRXd
	CLRF	Flags4
	INCF	Param78,W
	SKPZ		;Is this a sync byte?
	GOTO	RS232_Parse	; No
	CLRF	Flags4
	BCF	DataValidFlag
	GOTO	RS232_Parse_Sync
;
RS232_Parse_Done	CLRF	Flags4
	MOVF	RX_TempADC_Value,W
	MOVWF	RX_ADC_Value
	MOVF	RX_TempADC_Value+1,W
	MOVWF	RX_ADC_Value+1
	MOVF	RX_TempButtons,W
	MOVWF	RX_Buttons
	BSF	DataValidFlag
	MOVLW	d'120'
	MOVWF	Timer3Lo
	GOTO	RS232_Parse
;
;